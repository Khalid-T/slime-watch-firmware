#include "doctor.h"
#include "lastdeath.h"          /* THE LAST DEATH: the first line (how the body last died), the hour's verdict */
#include "wdt.h"                /* THE LOOP'S PULSE: the clause on the build line */
#include "touch.h"
#include "app.h"
#include "store.h"
#include "net.h"
#include "ble.h"                /* BLUETOOTH: the stack's state on the radio line; both stacks up = a wrong thing */
#include "blegate.h"
#include "ear.h"                /* THE EAR'S LEDGER: the nap's two kinds, their mV/h, the gear */
#include "link.h"
#include "daylog.h"
#include "rest.h"
#include "house.h"
#include "wardrobe.h"   /* THE WRIST WARDROBE: mounted? count worn theme -- one line */
#include "gesture.h"
#include "clockwork.h"
#include "sky.h"
#include "grain.h"
#include "bus.h"
#include "imu.h"
#include "gel.h"                /* GEL_WALL_NAMES */
#include "build_id.h"           /* generated by tools/build_id.py at build time (gitignored) */
#include <Arduino.h>
#include <LittleFS.h>
#include <string.h>
#include <stdio.h>
#include <stdarg.h>
#include <stdlib.h>

/* the linker's own bounds of the image's static RAM (ESP-IDF's
 * memory.ld: .data then .bss in DRAM) -- the number `pio run` prints as
 * RAM, read off the running image */
extern "C" char _data_start[], _data_end[], _bss_start[], _bss_end[];

/* the verdict's lines, each with its cause */
static const uint32_t HEAP_FLOOR   = 60 * 1024;   /* the rule since the box door: >= 60 KB free with the TLS session held */
static const uint32_t HEAP_DIP     = 30 * 1024;   /* the low-water mark since boot: under this something nearly starved (esp-sha's "Failed to allocate" was here) */
static const float    FPS_MOVING   = 35.0f;       /* the frame rule: >= 35 while anything moves */
static const float    FPS_SAMPLE_S = 1.0f;        /* judge the moving rate only from a second or more of motion in the window */
static const uint32_t SETTLE_S     = 120;         /* the join, NTP and today's first minute need this long after boot before their absence is wrong */
static const uint32_t LINK_S       = 180;         /* a link that has not come up in this long is not coming up */

static int put(char *out, size_t cap, int n, const char *fmt, ...)
{
    if (n < 0 || (size_t)n >= cap) return n;
    va_list ap; va_start(ap, fmt);
    int w = vsnprintf(out + n, cap - (size_t)n, fmt, ap);
    va_end(ap);
    if (w < 0) return n;
    n += w;
    return (size_t)n >= cap ? (int)cap - 1 : n;
}

/* the day files on the disk: how many, how many closed days have no
 * `.ok` beside them (daylog.cpp's synced marker; today's open file is
 * not counted), the oldest of those */
static void day_files(int *files, int *unsynced, uint32_t *oldest)
{
    *files = 0; *unsynced = 0; *oldest = 0;
    File dir = LittleFS.open("/day");
    if (!dir) return;
    uint32_t today = clock_local_date();
    File f;
    while ((f = dir.openNextFile())) {
        const char *n = f.name();
        bool bin = strstr(n, ".bin") != NULL;
        uint32_t d = (uint32_t)strtoul(n, NULL, 10);
        f.close();
        if (!bin || !d) continue;
        (*files)++;
        if (d == today) continue;
        char p[32]; snprintf(p, sizeof p, "/day/%08lu.ok", (unsigned long)d);
        if (!LittleFS.exists(p)) { (*unsynced)++; if (!*oldest || d < *oldest) *oldest = d; }
    }
    dir.close();
}

/* the door the link holds, from `desk list`'s own lines */
static void held_door(char *out, size_t cap)
{
    if (link_docked()) { strncpy(out, "the dock (usb)", cap - 1); out[cap - 1] = 0; return; }
    for (int i = 0; i < store.n_doors; i++) {
        char l[160]; link_door_line(i, l, sizeof l);
        if (strstr(l, "(held)")) {
            const door_t *d = &store.doors[i];
            snprintf(out, cap, "door %d %s:%u %s", i, d->host, d->port, d->tls ? "tls" : "plain");
            return;
        }
    }
    snprintf(out, cap, "no door held (%u known)", store.n_doors);
}

static const char *bom_word(uint8_t bit)
{
    if (!bus_on_bom(bit)) return "off";
    return bus_present(bit) ? "ANSWERED" : "absent";
}

int doctor_text(char *out, size_t cap)
{
    int n = 0;
    uint32_t up_s = millis() / 1000;
    uint32_t heap = ESP.getFreeHeap(), heap_min = ESP.getMinFreeHeap(), heap_big = ESP.getMaxAllocHeap();
    uint32_t psram = ESP.getFreePsram(), psram_all = ESP.getPsramSize();
    uint32_t stat = (uint32_t)(_data_end - _data_start) + (uint32_t)(_bss_end - _bss_start);
    float fps_mov = 0, mov_s = 0; bool idle_now = false;
    app_frame_stats(&fps_mov, &mov_s, &idle_now);

    /* 0. THE LAST DEATH: how the body last died, the life before it, the counters */
    { char d[200]; death_status(d, sizeof d); n = put(out, cap, n, "%s\n", d); }
    /* 1. the build and the body's memory (+ THE LOOP'S PULSE's clause) */
    char wd[48]; wdt_status(wd, sizeof wd);
    n = put(out, cap, n, "doctor: build %s (%s, %s) | up %lu s | heap %lu free, min %lu, largest %lu | psram %lu of %lu free | static %lu B (data+bss) | %s\n",
            BUILD_ID, BUILD_ENV, BUILD_DATE, (unsigned long)up_s, (unsigned long)heap, (unsigned long)heap_min,
            (unsigned long)heap_big, (unsigned long)psram, (unsigned long)psram_all, (unsigned long)stat, wd);
    /* 2. the frame */
    n = put(out, cap, n, "frame: fps %.1f over the last window (moving %.1f over %.1f s; %s now) | screen %s, wall %s phi %.0f\n",
            app.fps, fps_mov, mov_s, idle_now ? "the idle 20 Hz" : "40 fps",
            APP_STATE_NAMES[app.state], GEL_WALL_NAMES[app.wall & 3], app.phi_deg);
    /* 3. the house */
    { char h[200]; house_status(h, sizeof h); n = put(out, cap, n, "%s\n", h); }
    /* 3b. THE WRIST WARDROBE: the art partition, what is worn, the theme (not mounted = the built-in gel, never a verdict) */
    { char w[320]; wardrobe_status(w, sizeof w); n = put(out, cap, n, "%s\n", w); }
    /* 4. the link */
    {
        char via[120]; held_door(via, sizeof via);
        char radio[160]; link_radio_line(radio, sizeof radio);   /* THE RADIO BUDGET: the same line `link` prints */
        uint32_t ok = link_last_ok_ms();
        char bx[96]; link_box_line(bx, sizeof bx);                /* THE BOX'S STATUS: holder / last day / words waiting / the box's sky */
        char rf[200]; link_refusal_line(rf, sizeof rf);           /* THE REFUSAL SAID ONCE: the doors' repeated words, counted ("" = none) */
        n = put(out, cap, n, "link: %s via %s | holding %s | last ok %s%lu s ago | %d days synced | beat-worn %s (%s) | word %s | %s | radio %s%s%s\n",
                link_state_name(), via, link_holding() ? "yes" : "no", ok ? "" : "never; ",
                ok ? (unsigned long)((millis() - ok) / 1000) : (unsigned long)up_s, link_days_synced(),
                store.beat_worn ? "on" : "off", house_worn() ? "worn" : "still", store.key[0] ? "key set" : "NO KEY", bx, radio,
                rf[0] ? " | " : "", rf);
    }
    /* 5. the radio, BLE and the clock */
    {
        char w[160]; net_status(w, sizeof w);
        char b[300]; ble_status(b, sizeof b);      /* BLUETOOTH: up / down (why) / OFF, the client's state, the heap with it */
        struct tm lt; uint32_t ep; clock_local(&lt, &ep);
        n = put(out, cap, n, "%s | clock %s%04d-%02d-%02d %02d:%02d from %s (tz %+d)\n%s\n", w,
                clock_is_set() ? "" : "UNSET ", lt.tm_year + 1900, lt.tm_mon + 1, lt.tm_mday, lt.tm_hour, lt.tm_min,
                clock_source(), (int)store.tz_min, b);
    }
    /* 5b. THE EAR'S LEDGER AND ITS LOW GEAR: deep / awake-ear minutes, the cell's slope by kind, the gear */
    { char e[400]; ear_status(e, sizeof e); n = put(out, cap, n, "%s\n", e); }
    /* 6. the day log and the night */
    {
        int files, unsynced; uint32_t oldest;
        day_files(&files, &unsynced, &oldest);
        uint32_t today = clock_local_date();
        daylog_sum_t s; bool have = today && wrist_sum(today, &s);
        if (wrist_disk_refused()) n = put(out, cap, n, "day: DISK FAILED TO MOUNT (the files may be there; `day format` wipes it); %d unlogged min", wrist_unlogged_min());   /* THE DISK ASKS BEFORE IT FORMATS */
        else
        n = put(out, cap, n, "day: %d file%s (%lu KB of %lu), today %08lu %d rows, %lu steps, %d unlogged min, %d unsynced",
                files, files == 1 ? "" : "s", (unsigned long)(LittleFS.usedBytes() / 1024), (unsigned long)(LittleFS.totalBytes() / 1024),
                (unsigned long)today, have ? s.minutes : 0, (unsigned long)wrist_steps_today(), wrist_unlogged_min(), unsynced);
        if (unsynced) n = put(out, cap, n, " (oldest %08lu)", (unsigned long)oldest);
        rest_span_t sp;
        if (rest_last_span(&sp)) {
            char hm[8] = "--:--";
            if (sp.end_minute >= 0) snprintf(hm, sizeof hm, "%02d:%02d", sp.end_minute / 60, sp.end_minute % 60);
            n = put(out, cap, n, " | night: last span %s %.1f h to %s, %d awakening%s%s\n",
                    sp.night ? "THE NIGHT" : "a nap", sp.minutes / 60.0f, hm, sp.awakenings, sp.awakenings == 1 ? "" : "s",
                    rest_rebuilt() ? " (rebuilt from the files)" : "");
        } else n = put(out, cap, n, " | night: no span yet (%s)\n", rest_state_name());
    }
    /* 7. the hardware room and the small states */
    {
        int am = clockwork_alarm();
        char alarm[12]; if (am < 0) strcpy(alarm, "off"); else snprintf(alarm, sizeof alarm, "%02d:%02d", am / 60, am % 60);
        const link_grain_t *g = link_grain();
        char b0[64]; unstick_bom(bus0_state(), millis(), b0, sizeof b0);   /* THE BUS UNSTUCK: `bus0 ok (N recoveries, last M min ago)` */
        n = put(out, cap, n, "bom: haptic %s motor %s gauge %s rtc %s ppg %s button %s (imu %s) | touch %s (id 0x%02X, %u unanswered polls) | %s | lock %s | alarm %s | sky %s%s%s%s | grain %s",
                bom_word(BOM_HAPTIC), bom_word(BOM_MOTOR), bom_word(BOM_GAUGE), bom_word(BOM_RTC), bom_word(BOM_PPG), bom_word(BOM_BUTTON),
                imu_addr() ? "found" : "NOT FOUND",
                touch_alive() ? "answers" : "SILENT", touch_chip_id(), (unsigned)touch_nacks(), b0,
                gesture_locked() ? "ON" : "off", alarm,
                sky_known() ? sky_word(0) : "none", sky_word(1)[0] ? " " : "", sky_word(1), "",
                g->have ? "" : "never told (the nominal creature)");
        if (g->have) n = put(out, cap, n, "seed %d regard %+.2f night %d quiet %s mood %s", g->seed, g->regard, g->night, g->quiet, g->mood);
        n = put(out, cap, n, "\n");
    }
    /* 8. the verdict: the first thing wrong */
    const char *bad = NULL; char why[120] = "";
    if (wrist_disk_refused()) bad = "DISK FAILED TO MOUNT (the files may be there; `day format` wipes it; the minutes count as unlogged meanwhile)";   /* THE DISK ASKS BEFORE IT FORMATS: the verdict leads with it */
    else if (!app_fb) bad = "no framebuffer (fb alloc FAILED at boot)";
    else if (blegate_both(ble_is_up(), net_radio_is_on())) bad = "BLE and the WiFi radio both up (ruling 58: never both -- a bug in net.cpp's edges)";
    else if (unstick_verdict(bus0_state(), millis(), app.state != 2, why, sizeof why)) bad = why;   /* THE BUS UNSTUCK: an IMU gone silent (before "no IMU": a failed recovery drops its address), or a touch chip silent while the IMU answers */
    else if (!imu_addr()) bad = "no IMU found (QMI8658): no gravity, no steps, no wake";
    else if (LittleFS.totalBytes() == 0) bad = "no disk (LittleFS did not mount): no day log";
    else if (death_verdict_line(why, sizeof why, up_s)) bad = why;   /* THE LAST DEATH: a crash inside the hour is the morning's first thing */
    else if (heap < HEAP_FLOOR) { snprintf(why, sizeof why, "heap under the 60 KB floor: %lu free", (unsigned long)heap); bad = why; }
    else if (heap_min < HEAP_DIP) { snprintf(why, sizeof why, "the heap dipped to %lu since boot (under 30 KB: something nearly starved)", (unsigned long)heap_min); bad = why; }
    else if (mov_s >= FPS_SAMPLE_S && fps_mov > 0 && fps_mov < FPS_MOVING) { snprintf(why, sizeof why, "%.1f fps while moving (the rule is >= 35)", fps_mov); bad = why; }
    else if (!clock_is_set() && up_s > SETTLE_S) bad = "no clock: NTP, the desk's hello, the bonded phone, or `clock <epoch>`";
    else if (!store.n_nets) bad = "no networks remembered (`wifi <ssid> <psk>`)";
    else if (!store.n_doors) bad = "no doors (`desk add <host> <port> [tls]`)";
    else if (!store.key[0]) bad = "no link key (`key <hex>`: the desk's WATCH_KEY)";
    else if (!link_last_ok_ms() && up_s > LINK_S) { snprintf(why, sizeof why, "the link never came up in %lu s (wifi %s)", (unsigned long)up_s, net_state_name()); bad = why; }
    else if (clock_is_set() && up_s > SETTLE_S) {
        daylog_sum_t s;
        if (!wrist_sum(clock_local_date(), &s)) bad = "no day file for today yet";
    }
    if (!bad) {
        static const uint8_t bits[] = { BOM_HAPTIC, BOM_GAUGE, BOM_RTC, BOM_PPG };
        static const char *names[] = { "haptic", "gauge", "rtc", "ppg" };
        for (int i = 0; i < 4 && !bad; i++)
            if (bus_on_bom(bits[i]) && !bus_present(bits[i])) { snprintf(why, sizeof why, "bom %s on but nothing answered at its address (`bus`)", names[i]); bad = why; }
    }
    /* THE RADIO BUDGET: a radio off by choice is well; one wanted (a due dial) and not up after the settle is not */
    if (!bad && !net_up() && link_radio_wanted() && up_s > SETTLE_S && app.state != 2) { snprintf(why, sizeof why, "wifi %s while a dial is due (awake, %lu s up)", net_state_name(), (unsigned long)up_s); bad = why; }
    n = put(out, cap, n, "VERDICT: %s\n", bad ? bad : "all well");
    return n;
}

void doctor_print(void)
{
    char *b = (char *)malloc(DOCTOR_CAP);
    if (!b) { Serial.println("doctor: no heap for the report itself -- that is the verdict"); return; }
    doctor_text(b, DOCTOR_CAP);
    Serial.print(b);
    free(b);
}

const char *doctor_build_id(void) { return BUILD_ID; }
